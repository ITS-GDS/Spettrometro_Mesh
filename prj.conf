## CMakeLists.txt
```
cmake_minimum_required(VERSION 3.20.0)
find_package(Zephyr REQUIRED HINTS $ENV{ZEPHYR_BASE})
project(as7341_mesh_node)
target_sources(app PRIVATE src/main.c src/led.c src/sensor.c src/as7341.c src/shell.c)
```

## prj.conf
```kconfig
CONFIG_NCS_SAMPLES_DEFAULTS=y
CONFIG_NCS_APPLICATION_BOOT_BANNER_STRING="AS7341 Mesh Node"
CONFIG_SYSTEM_WORKQUEUE_STACK_SIZE=2048
CONFIG_MAIN_STACK_SIZE=2048
CONFIG_FLASH=y
CONFIG_FLASH_MAP=y
CONFIG_NVS=y
CONFIG_NVS_LOOKUP_CACHE=y
CONFIG_SETTINGS=y
CONFIG_SETTINGS_NVS_NAME_CACHE=y
CONFIG_HWINFO=y
CONFIG_FPU=y
CONFIG_CBPRINTF_FP_SUPPORT=y
CONFIG_SOC_FLASH_NRF_PARTIAL_ERASE=y
CONFIG_GPIO=y
CONFIG_I2C=y
CONFIG_SENSOR=y
CONFIG_LOG=y
CONFIG_LOG_MODE_DEFERRED=y

CONFIG_BT=y
CONFIG_BT_DEVICE_NAME="AS7341 Light"
CONFIG_BT_L2CAP_TX_BUF_COUNT=8
CONFIG_BT_OBSERVER=y
CONFIG_BT_PERIPHERAL=y
CONFIG_BT_SETTINGS=y
CONFIG_BT_CTLR_LE_ENC=n
CONFIG_BT_PHY_UPDATE=n
CONFIG_BT_CTLR_CHAN_SEL_2=n
CONFIG_BT_CTLR_MIN_USED_CHAN=n
CONFIG_BT_CTLR_PRIVACY=n

CONFIG_BT_MESH=y
CONFIG_BT_MESH_RELAY=y
CONFIG_BT_MESH_TX_SEG_MAX=10
CONFIG_BT_MESH_PB_GATT=y
CONFIG_BT_MESH_GATT_PROXY=y
CONFIG_BT_MESH_PROXY_USE_DEVICE_NAME=y
CONFIG_BT_MESH_MODEL_EXTENSIONS=y
CONFIG_BT_MESH_MODEL_EXTENSION_LIST_SIZE=10
CONFIG_BT_MESH_SENSOR_SRV=y
CONFIG_BT_MESH_SENSOR_SRV_SENSORS_MAX=4
# Lo spettro (0xF341) ha 10 canali: il default (5) fa scrivere spec_value() oltre l'array
CONFIG_BT_MESH_SENSOR_CHANNELS_MAX=10
CONFIG_BT_MESH_ACCESS_DELAYABLE_MSG_CHUNK_SIZE=12
CONFIG_BT_MESH_ACCESS_DELAYABLE_MSG_CHUNK_COUNT=60
CONFIG_BT_MESH_TX_SEG_MSG_COUNT=3
CONFIG_BT_MESH_ACCESS_DELAYABLE_MSG_COUNT=10
CONFIG_BT_COMPANY_ID=0x0059

# Shell su USB CDC (reset locale: "node reset", stato: "node status")
CONFIG_SHELL=y
# Remote Provisioning Server: il nodo fa da ponte per provisionare altri nodi via mesh
CONFIG_BT_MESH_RPR_SRV=y
```

## src/main.c
```c
/* Nodo BLE Mesh AS7341: composition, provisioning e avvio.
 * Sensore in sensor.c, LED di stato in led.c, shell USB in shell.c.
 */
#include <string.h>
#include <zephyr/kernel.h>
#include <zephyr/drivers/hwinfo.h>
#include <zephyr/settings/settings.h>
#include <zephyr/logging/log.h>
#include <zephyr/bluetooth/bluetooth.h>
#include <zephyr/bluetooth/mesh.h>
#include <zephyr/bluetooth/mesh/rpr_srv.h>
#include "node.h"

LOG_MODULE_REGISTER(as7341_node, LOG_LEVEL_INF);

#define PROV_BEARERS  (BT_MESH_PROV_ADV | BT_MESH_PROV_GATT)
#define RESET_SHOW_MS 2000

static volatile enum node_state state = ST_UNPROV;
static uint8_t dev_uuid[16];

enum node_state node_get_state(void)
{
	return state;
}

/* ---- Reset ------------------------------------------------------------ */

static void rearm_work_fn(struct k_work *w)
{
	/* Dopo un reset lo stack non riabilita da solo i bearer di provisioning. */
	int err = bt_mesh_prov_enable(PROV_BEARERS);

	if (err) {
		LOG_ERR("bt_mesh_prov_enable err=%d", err);
	}
	state = ST_UNPROV;
	LOG_INF("reset completato: in attesa di provisioning");
}
static K_WORK_DELAYABLE_DEFINE(rearm_work, rearm_work_fn);

void node_reset_begin(void)
{
	state = ST_RESET;
	sensor_invalidate();
	k_work_reschedule(&rearm_work, K_MSEC(RESET_SHOW_MS));
}

/* ---- Composition ------------------------------------------------------ */

BT_MESH_HEALTH_PUB_DEFINE(health_pub, 0);

static void attention_on(const struct bt_mesh_model *mod)
{
	led_attention(true);
}

static void attention_off(const struct bt_mesh_model *mod)
{
	led_attention(false);
}

static const struct bt_mesh_health_srv_cb health_cb = {
	.attn_on = attention_on,
	.attn_off = attention_off,
};

static struct bt_mesh_health_srv health_srv = {
	.cb = &health_cb,
};

static struct bt_mesh_elem elements[] = {
	BT_MESH_ELEM(0,
		     BT_MESH_MODEL_LIST(BT_MESH_MODEL_CFG_SRV,
					BT_MESH_MODEL_HEALTH_SRV(&health_srv, &health_pub),
					BT_MESH_MODEL_SENSOR_SRV(&sensor_srv),
					BT_MESH_MODEL_RPR_SRV),
		     BT_MESH_MODEL_NONE),
};

static const struct bt_mesh_comp comp = {
	.cid = CONFIG_BT_COMPANY_ID,
	.elem = elements,
	.elem_count = ARRAY_SIZE(elements),
};

/* ---- Provisioning ----------------------------------------------------- */

static void prov_link_open(bt_mesh_prov_bearer_t bearer)
{
	LOG_INF("provisioning: link aperto (bearer=%d)", bearer);
	state = ST_LINK;
}

static void prov_link_close(bt_mesh_prov_bearer_t bearer)
{
	LOG_INF("provisioning: link chiuso (bearer=%d)", bearer);
	if (state == ST_LINK) {
		state = bt_mesh_is_provisioned() ? ST_PROV : ST_UNPROV;
	}
}

static void prov_complete(uint16_t net_idx, uint16_t addr)
{
	LOG_INF("provisionato: net_idx=%u addr=0x%04x", net_idx, addr);
	state = ST_PROV;
}

/* Node Reset dalla mesh: lo stack ha gia' cancellato le chiavi. */
static void prov_reset(void)
{
	LOG_INF("reset da mesh (Node Reset)");
	node_reset_begin();
}

static const struct bt_mesh_prov prov = {
	.uuid = dev_uuid,
	.link_open = prov_link_open,
	.link_close = prov_link_close,
	.complete = prov_complete,
	.reset = prov_reset,
};

/* ---- Avvio ------------------------------------------------------------ */

static void bt_ready(int err)
{
	if (err) {
		LOG_ERR("bt init err=%d", err);
		return;
	}
	err = bt_mesh_init(&prov, &comp);
	if (err) {
		LOG_ERR("mesh init err=%d", err);
		return;
	}
	settings_load();
	/* No-op se settings_load() ha ripristinato un provisioning. */
	bt_mesh_prov_enable(PROV_BEARERS);
	state = bt_mesh_is_provisioned() ? ST_PROV : ST_UNPROV;
	LOG_INF("mesh pronta, %s",
		bt_mesh_is_provisioned() ? "provisionato" : "in attesa di provisioning");
}

int main(void)
{
	uint8_t id[8];

	led_init();
	sensor_start();

	/* UUID dal Device ID hardware: stabile tra i riavvii. */
	hwinfo_get_device_id(id, sizeof(id));
	memcpy(dev_uuid, id, sizeof(id));
	memcpy(dev_uuid + 8, id, sizeof(id));

	int err = bt_enable(bt_ready);

	if (err) {
		LOG_ERR("bt_enable err=%d", err);
	}
	return 0;
}
```

## src/as7341.c
```c
#include <zephyr/kernel.h>
#include <zephyr/device.h>
#include <zephyr/devicetree.h>
#include <zephyr/drivers/i2c.h>
#include <zephyr/logging/log.h>
#include "as7341.h"

LOG_MODULE_REGISTER(as7341, LOG_LEVEL_INF);

#define AS_ENABLE  0x80
#define AS_ATIME   0x81
#define AS_STATUS2 0xA3
#define AS_CFG1    0xAA
#define AS_CFG6    0xAF
#define AS_ASTEP_L 0xCA
#define AS_CH0_L   0x95

#define AS_ATIME_V 29
#define AS_ASTEP_V 599
/* tempo di integrazione = (ATIME+1)*(ASTEP+1)*2.78 us ~ 50 ms */
#define AS_TINT_MS ((AS_ATIME_V + 1) * (AS_ASTEP_V + 1) * 2.78f / 1000.0f)

#define AS_GAIN_DEFAULT 6 /* 32x */
#define AS_GAIN_MAX     9
#define CLEAR_HIGH      50000 /* sopra: riduci il guadagno */
#define CLEAR_LOW       3000  /* sotto: aumentalo */

/* Fattore di taratura conteggi-base -> lux: indicativo, da tarare con un luxmetro. */
#define LUX_K 0.35f

/* CIE 1931 xbar/ybar/zbar alle lunghezze d'onda centrali di F1..F8 (415..680 nm). */
static const float cie_x[8] = {0.044f, 0.336f, 0.096f, 0.036f, 0.514f, 1.026f, 0.642f, 0.047f};
static const float cie_y[8] = {0.001f, 0.030f, 0.139f, 0.607f, 0.995f, 0.757f, 0.265f, 0.017f};
static const float cie_z[8] = {0.207f, 1.772f, 0.813f, 0.060f, 0.006f, 0.001f, 0.000f, 0.000f};

/* SMUX: F1-F4 + clear + NIR, poi F5-F8 + clear + NIR (da datasheet/Adafruit). */
static const uint8_t smux_f1f4[20] = {0x30, 0x01, 0x00, 0x00, 0x00, 0x42, 0x00, 0x00, 0x50, 0x00,
				      0x00, 0x00, 0x20, 0x04, 0x00, 0x30, 0x01, 0x50, 0x00, 0x06};
static const uint8_t smux_f5f8[20] = {0x00, 0x00, 0x00, 0x40, 0x02, 0x00, 0x10, 0x03, 0x50, 0x10,
				      0x03, 0x00, 0x00, 0x00, 0x24, 0x00, 0x00, 0x50, 0x00, 0x06};

static const struct device *bus;
static uint8_t gain = AS_GAIN_DEFAULT;

static int wr(uint8_t reg, uint8_t val)
{
	return i2c_reg_write_byte(bus, AS7341_ADDR, reg, val);
}

static int rd(uint8_t reg, uint8_t *val)
{
	return i2c_reg_read_byte(bus, AS7341_ADDR, reg, val);
}

static int set_smux(const uint8_t *cfg)
{
	int err = wr(AS_ENABLE, 0x01); /* PON, spettrale off */

	if (!err) {
		err = wr(AS_CFG6, 0x10); /* scrittura SMUX */
	}
	for (int i = 0; !err && i < 20; i++) {
		err = wr(i, cfg[i]);
	}
	if (!err) {
		err = wr(AS_ENABLE, 0x11); /* PON | SMUXEN */
	}
	for (int i = 0; !err && i < 50; i++) {
		uint8_t e;

		k_msleep(2);
		err = rd(AS_ENABLE, &e);
		if (!err && !(e & 0x10)) {
			return 0;
		}
	}
	return err ? err : -ETIMEDOUT;
}

/* Attende AVALID (dato spettrale pronto). */
static int wait_data(void)
{
	for (int i = 0; i < 100; i++) {
		uint8_t st;
		int err;

		k_msleep(10);
		err = rd(AS_STATUS2, &st);
		if (err || (st & 0x40)) {
			return err;
		}
	}
	return -ETIMEDOUT;
}

/* Misura 6 canali con la mappa SMUX data; out = 4 filtri, clear, NIR. */
static int measure(const uint8_t *cfg, uint16_t out[6])
{
	uint8_t buf[12];
	int err = set_smux(cfg);

	if (!err) {
		err = wr(AS_ENABLE, 0x03); /* PON | SP_EN */
	}
	if (!err) {
		err = wait_data();
	}
	if (!err) {
		err = i2c_burst_read(bus, AS7341_ADDR, AS_CH0_L, buf, sizeof(buf));
	}
	wr(AS_ENABLE, 0x01);
	if (err) {
		return err;
	}
	for (int i = 0; i < 6; i++) {
		out[i] = buf[2 * i] | (buf[2 * i + 1] << 8);
	}
	return 0;
}

static int init_on(const struct device *dev)
{
	uint8_t id;

	bus = dev;
	if (!device_is_ready(dev) || rd(AS7341_REG_ID, &id) || (id >> 2) != 0x09) {
		return -ENODEV;
	}
	gain = AS_GAIN_DEFAULT;
	return wr(AS_ENABLE, 0x01) ?: wr(AS_ATIME, AS_ATIME_V) ?:
	       wr(AS_ASTEP_L, AS_ASTEP_V & 0xff) ?: wr(AS_ASTEP_L + 1, AS_ASTEP_V >> 8) ?:
	       wr(AS_CFG1, gain);
}

bool as7341_probe(void)
{
	if (init_on(DEVICE_DT_GET(DT_NODELABEL(i2c1))) == 0) {
		LOG_INF("AS7341 su i2c1 (D4/D5)");
	} else if (init_on(DEVICE_DT_GET(DT_NODELABEL(i2c0))) == 0) {
		LOG_INF("AS7341 su i2c0 (D9/D10)");
	} else {
		bus = NULL;
	}
	return bus != NULL;
}

bool as7341_present(void)
{
	return bus != NULL;
}

void as7341_drop(void)
{
	bus = NULL;
}

/* Scelta guadagno automatica sul canale clear. */
static void autogain(uint16_t clear)
{
	uint8_t g = gain;

	if (clear > CLEAR_HIGH && g > 0) {
		g--;
	} else if (clear < CLEAR_LOW && g < AS_GAIN_MAX) {
		g++;
	}
	if (g != gain) {
		gain = g;
		wr(AS_CFG1, gain);
	}
}

int as7341_sample(struct as7341_reading *out)
{
	uint16_t a[6], b[6];
	int err = measure(smux_f1f4, a) ?: measure(smux_f5f8, b);

	if (err) {
		return err;
	}
	for (int i = 0; i < 4; i++) {
		out->ch[i] = a[i];
		out->ch[4 + i] = b[i];
	}
	out->clear = a[4];
	out->nir = a[5];
	out->gain = gain;
	out->norm = 1.0f / ((gain ? (float)(1u << (gain - 1)) : 0.5f) * AS_TINT_MS);

	float X = 0, Y = 0, Z = 0;

	for (int i = 0; i < 8; i++) {
		float c = out->ch[i] * out->norm;

		X += c * cie_x[i];
		Y += c * cie_y[i];
		Z += c * cie_z[i];
	}
	out->lux = Y * LUX_K;
	out->cx = out->cy = 0;
	out->cct = 0;
	if (X + Y + Z > 0.0f) {
		float x = X / (X + Y + Z), y = Y / (X + Y + Z);
		float n = (x - 0.3320f) / (0.1858f - y); /* McCamy */
		float cct = 449.0f * n * n * n + 3525.0f * n * n + 6823.3f * n + 5520.33f;

		out->cx = x;
		out->cy = y;
		out->cct = cct < 800.0f ? 800 : cct > 65000.0f ? 65000 : (uint32_t)cct;
	}
	autogain(out->clear);
	return 0;
}
```

## src/as7341.h
```c
/* Driver minimale AS7341 (Zephyr non ne ha uno): 11 canali spettrali, I2C 0x39. */
#pragma once

#include <stdbool.h>
#include <stdint.h>

#define AS7341_ADDR   0x39
#define AS7341_REG_ID 0x92

struct as7341_reading {
	uint16_t ch[8];		/* F1..F8 (415..680 nm), conteggi grezzi */
	uint16_t clear, nir;
	uint8_t gain;		/* codice CFG1: guadagno = 2^(gain-1), 0 => 0.5x */
	float norm;		/* 1 / (guadagno * tempo di integrazione in ms) */
	float lux;		/* grezzo, prima della calibrazione utente */
	float cx, cy;		/* cromaticita' CIE 1931 */
	uint32_t cct;		/* kelvin */
};

/* Cerca il sensore su i2c1 (D4/D5) poi i2c0 (D9/D10). */
bool as7341_probe(void);
bool as7341_present(void);
/* Dimentica il bus: la prossima as7341_probe() riparte da zero. */
void as7341_drop(void);
/* Misura F1..F8 + clear + NIR e calcola lux/CCT/xy. Adatta il guadagno per la prossima. */
int as7341_sample(struct as7341_reading *out);
```

## src/led.c
```c
/* LED RGB di stato.
 * Provisionabile : blu, lampeggio breve ogni 1 s
 * Provisioning   : blu fisso (link PB-ADV/PB-GATT aperto)
 * Provisionato   : verde, impulso breve ogni 3 s
 * Reset          : rosso, lampeggio veloce, poi torna provisionabile
 * Attention      : 4 lampi bianchi + pausa (Health Server, ha priorita')
 */
#include <zephyr/kernel.h>
#include <zephyr/drivers/gpio.h>
#include "node.h"

#define LED_TICK_MS 100

/* Il rosso e' molto piu' efficiente degli altri canali: per ottenere un
 * bianco i tre canali usano un duty diverso (su 8 passi, timer a 250 us).
 */
#define WHITE_R 1
#define WHITE_G 8
#define WHITE_B 4
#define WHITE_STEP_US 250

static const struct gpio_dt_spec led_r = GPIO_DT_SPEC_GET(DT_ALIAS(led0), gpios);
static const struct gpio_dt_spec led_g = GPIO_DT_SPEC_GET(DT_ALIAS(led1), gpios);
static const struct gpio_dt_spec led_b = GPIO_DT_SPEC_GET(DT_ALIAS(led2), gpios);

static volatile bool attention;
static volatile bool attention_lit;
static uint32_t attention_t;

static void led_set(bool r, bool g, bool b)
{
	gpio_pin_set_dt(&led_r, r);
	gpio_pin_set_dt(&led_g, g);
	gpio_pin_set_dt(&led_b, b);
}

static void white_timer_fn(struct k_timer *t)
{
	static uint8_t ph;

	ph = (ph + 1) & 7;
	if (attention_lit) {
		gpio_pin_set_dt(&led_r, ph < WHITE_R);
		gpio_pin_set_dt(&led_g, ph < WHITE_G);
		gpio_pin_set_dt(&led_b, ph < WHITE_B);
	}
}
static K_TIMER_DEFINE(white_timer, white_timer_fn, NULL);

static void led_fn(struct k_work *w);
static K_WORK_DELAYABLE_DEFINE(led_work, led_fn);

static void led_fn(struct k_work *w)
{
	static uint32_t t;

	t++;
	if (attention) {
		/* 100 ms on / 100 ms off x4, poi 800 ms di pausa. */
		uint32_t p = attention_t++ % 12;
		bool on = p < 8 && !(p & 1);

		attention_lit = on;
		if (!on) {
			led_set(false, false, false);
		}
	} else {
		switch (node_get_state()) {
		case ST_UNPROV:
			led_set(false, false, (t % 10) == 0);
			break;
		case ST_LINK:
			led_set(false, false, true);
			break;
		case ST_PROV:
			led_set(false, (t % 30) == 0, false);
			break;
		case ST_RESET:
			led_set(t & 1, false, false);
			break;
		}
	}
	k_work_reschedule(&led_work, K_MSEC(LED_TICK_MS));
}

void led_attention(bool on)
{
	if (on) {
		attention_t = 0;
		attention = true;
		k_timer_start(&white_timer, K_USEC(WHITE_STEP_US), K_USEC(WHITE_STEP_US));
		return;
	}
	attention = false;
	attention_lit = false;
	k_timer_stop(&white_timer);
	led_set(false, false, false);
}

void led_init(void)
{
	const struct gpio_dt_spec *leds[] = {&led_r, &led_g, &led_b};

	for (int i = 0; i < ARRAY_SIZE(leds); i++) {
		if (gpio_is_ready_dt(leds[i])) {
			gpio_pin_configure_dt(leds[i], GPIO_OUTPUT_INACTIVE);
		}
	}
	k_work_reschedule(&led_work, K_MSEC(LED_TICK_MS));
}
```

## src/node.h
```c
/* Interfaccia condivisa tra i moduli del nodo. */
#pragma once

#include <stdbool.h>
#include <stddef.h>
#include <zephyr/drivers/sensor.h>
#include <bluetooth/mesh/models.h>
#include "as7341.h"

enum node_state { ST_UNPROV, ST_LINK, ST_PROV, ST_RESET };

/* main.c */
enum node_state node_get_state(void);
void node_reset_begin(void);

/* led.c */
void led_init(void);
void led_attention(bool on);

/* sensor.c */
struct sensor_snap {
	struct as7341_reading r;
	float lux_k; /* coefficiente di calibrazione utente */
};

extern struct bt_mesh_sensor_srv sensor_srv;
void sensor_start(void);
void sensor_invalidate(void);
/* Copia l'ultima misura. Ritorna false se non ce n'e' una valida. */
bool sensor_snapshot(struct sensor_snap *s);
```

## src/sensor.c
```c
/* Sensor Server: lux, CCT, cromaticita' (standard SIG) e spettro (0xF341, custom).
 * La misura vive in una cache protetta da mutex: la scrive il work di
 * campionamento, la leggono lo stack mesh e la shell.
 * Calibrazione lux dall'app: vedi CALIBRAZIONE-LUX.md.
 */
#include <string.h>
#include <zephyr/kernel.h>
#include <zephyr/settings/settings.h>
#include <zephyr/logging/log.h>
#include <zephyr/bluetooth/mesh.h>
#include <bluetooth/mesh/sensor_types.h>
#include "node.h"

LOG_MODULE_REGISTER(sensor, LOG_LEVEL_INF);

#define SAMPLE_PERIOD_S  5
#define PUBLISH_PERIOD_S 30
#define SAMPLE_FAILS_MAX 3

#define SPEC_CH       10
#define SPEC_PROP_ID  0xF341
#define SPEC_SCALE    100.0f
#define SPEC_SAT      65534 /* 0xFFFF e' "non noto" nel formato count_16 */

#define LUX_CAL_UNKNOWN 0xFFFFFFu

static K_MUTEX_DEFINE(lock);
static struct {
	bool valid;
	struct as7341_reading r;
} cache;

/* L'app scrive il lux reale R in centilux (Sensor Setting 0x004E, metodo Silvair):
 * coefficiente = R / lux grezzo attuale, salvato in flash.
 */
static struct {
	float k;
	uint32_t ref_cl; /* ultimo lux reale scritto dall'app (centilux) */
} lux_cal = {.k = 1.0f, .ref_cl = LUX_CAL_UNKNOWN};

bool sensor_snapshot(struct sensor_snap *s)
{
	k_mutex_lock(&lock, K_FOREVER);
	bool ok = cache.valid;

	if (ok) {
		s->r = cache.r;
		s->lux_k = lux_cal.k;
	}
	k_mutex_unlock(&lock);
	return ok;
}

void sensor_invalidate(void)
{
	k_mutex_lock(&lock, K_FOREVER);
	cache.valid = false;
	k_mutex_unlock(&lock);
}

/* ---- Calibrazione lux -------------------------------------------------- */

static int lux_cal_settings_set(const char *name, size_t len, settings_read_cb read_cb,
				void *cb_arg)
{
	if (!strcmp(name, "luxcal") && len == sizeof(lux_cal)) {
		read_cb(cb_arg, &lux_cal, sizeof(lux_cal));
		return 0;
	}
	return -ENOENT;
}
SETTINGS_STATIC_HANDLER_DEFINE(as7341, "as7341", NULL, lux_cal_settings_set, NULL, NULL);

static void lux_cal_get(struct bt_mesh_sensor_srv *srv, struct bt_mesh_sensor *sensor,
			const struct bt_mesh_sensor_setting *setting, struct bt_mesh_msg_ctx *ctx,
			struct bt_mesh_sensor_value *rsp)
{
	struct sensor_value v = {.val1 = lux_cal.ref_cl / 100,
				 .val2 = (lux_cal.ref_cl % 100) * 10000};

	if (lux_cal.ref_cl == LUX_CAL_UNKNOWN ||
	    bt_mesh_sensor_value_from_sensor_value(setting->type->channels[0].format, &v, rsp)) {
		rsp->format = setting->type->channels[0].format;
		memset(rsp->raw, 0xFF, 3);
	}
}

static int lux_cal_set(struct bt_mesh_sensor_srv *srv, struct bt_mesh_sensor *sensor,
		       const struct bt_mesh_sensor_setting *setting, struct bt_mesh_msg_ctx *ctx,
		       const struct bt_mesh_sensor_value *value)
{
	struct sensor_value v;
	int err = 0;

	k_mutex_lock(&lock, K_FOREVER);
	if (bt_mesh_sensor_value_to_sensor_value(value, &v) != BT_MESH_SENSOR_VALUE_NUMBER) {
		/* "non noto" (0xFFFFFF): azzera la calibrazione */
		lux_cal.k = 1.0f;
		lux_cal.ref_cl = LUX_CAL_UNKNOWN;
	} else {
		float real = sensor_value_to_float(&v);

		if (!cache.valid || cache.r.lux < 0.0005f || real <= 0.0f) {
			err = -EINVAL;
		} else {
			lux_cal.k = real / cache.r.lux;
			lux_cal.ref_cl = (uint32_t)(real * 100.0f + 0.5f);
			LOG_INF("calibrazione lux: reale %.2f, grezzo %.3f, k=%.3f", (double)real,
				(double)cache.r.lux, (double)lux_cal.k);
		}
	}
	if (!err) {
		err = settings_save_one("as7341/luxcal", &lux_cal, sizeof(lux_cal));
	}
	k_mutex_unlock(&lock);
	return err;
}

static const struct bt_mesh_sensor_setting lux_settings[] = {
	{
		.type = &bt_mesh_sensor_present_amb_light_level,
		.get = lux_cal_get,
		.set = lux_cal_set,
	},
};

/* ---- Sensori ----------------------------------------------------------- */

static const struct bt_mesh_sensor_descriptor desc = {
	.tolerance = {
		.negative = BT_MESH_SENSOR_TOLERANCE_ENCODE(0),
		.positive = BT_MESH_SENSOR_TOLERANCE_ENCODE(0),
	},
	.sampling_type = BT_MESH_SENSOR_SAMPLING_UNSPECIFIED,
	.period = 0,
	.update_interval = 0,
};

/* Fuori scala (-ERANGE) non e' un errore: il valore viene saturato. */
static int encode(const struct bt_mesh_sensor_format *fmt, const struct sensor_value *v,
		  struct bt_mesh_sensor_value *rsp)
{
	int err = bt_mesh_sensor_value_from_sensor_value(fmt, v, rsp);

	return (err && err != -ERANGE) ? err : 0;
}

static int lux_get(struct bt_mesh_sensor_srv *srv, struct bt_mesh_sensor *sensor,
		   struct bt_mesh_msg_ctx *ctx, struct bt_mesh_sensor_value *rsp)
{
	struct sensor_snap s;
	struct sensor_value v;

	if (!sensor_snapshot(&s)) {
		return -EAGAIN;
	}
	sensor_value_from_float(&v, s.r.lux * s.lux_k);
	return encode(sensor->type->channels[0].format, &v, rsp);
}

static int cct_get(struct bt_mesh_sensor_srv *srv, struct bt_mesh_sensor *sensor,
		   struct bt_mesh_msg_ctx *ctx, struct bt_mesh_sensor_value *rsp)
{
	struct sensor_snap s;
	struct sensor_value v = {0};

	if (!sensor_snapshot(&s)) {
		return -EAGAIN;
	}
	v.val1 = s.r.cct;
	return encode(sensor->type->channels[0].format, &v, rsp);
}

static int chrom_get(struct bt_mesh_sensor_srv *srv, struct bt_mesh_sensor *sensor,
		     struct bt_mesh_msg_ctx *ctx, struct bt_mesh_sensor_value *rsp)
{
	struct sensor_snap s;

	if (!sensor_snapshot(&s)) {
		return -EAGAIN;
	}
	const float xy[2] = {s.r.cx, s.r.cy};

	for (int i = 0; i < 2; i++) {
		struct sensor_value v;
		int err;

		sensor_value_from_float(&v, xy[i]);
		err = encode(sensor->type->channels[i].format, &v, &rsp[i]);
		if (err) {
			return err;
		}
	}
	return 0;
}

/* Spettro: 10 canali count_16 in ordine F1..F8, clear, NIR.
 * Valore = conteggi / (guadagno * ms) * 100, saturato a SPEC_SAT.
 */
#ifdef CONFIG_BT_MESH_SENSOR_LABELS
#define SPEC_CHAN(n) {.format = &bt_mesh_sensor_format_count_16, .name = n}
#else
#define SPEC_CHAN(n) {.format = &bt_mesh_sensor_format_count_16}
#endif

static const struct bt_mesh_sensor_channel spec_channels[SPEC_CH] = {
	SPEC_CHAN("F1 415nm"), SPEC_CHAN("F2 445nm"), SPEC_CHAN("F3 480nm"),
	SPEC_CHAN("F4 515nm"), SPEC_CHAN("F5 555nm"), SPEC_CHAN("F6 590nm"),
	SPEC_CHAN("F7 630nm"), SPEC_CHAN("F8 680nm"), SPEC_CHAN("Clear"), SPEC_CHAN("NIR"),
};

static const struct bt_mesh_sensor_type spec_type = {
	.id = SPEC_PROP_ID,
	.channel_count = SPEC_CH,
	.channels = spec_channels,
};

static int spec_get(struct bt_mesh_sensor_srv *srv, struct bt_mesh_sensor *sensor,
		    struct bt_mesh_msg_ctx *ctx, struct bt_mesh_sensor_value *rsp)
{
	struct sensor_snap s;
	uint16_t raw[SPEC_CH];

	if (!sensor_snapshot(&s)) {
		return -EAGAIN;
	}
	memcpy(raw, s.r.ch, sizeof(s.r.ch));
	raw[8] = s.r.clear;
	raw[9] = s.r.nir;
	for (int i = 0; i < SPEC_CH; i++) {
		float f = raw[i] * s.r.norm * SPEC_SCALE;
		struct sensor_value v = {.val1 = f > SPEC_SAT ? SPEC_SAT : (int32_t)f};
		int err = encode(spec_channels[i].format, &v, &rsp[i]);

		if (err) {
			return err;
		}
	}
	return 0;
}

static struct bt_mesh_sensor lux_sensor = {
	.type = &bt_mesh_sensor_present_amb_light_level,
	.get = lux_get,
	.descriptor = &desc,
	.settings = {.list = lux_settings, .count = ARRAY_SIZE(lux_settings)},
};
static struct bt_mesh_sensor cct_sensor = {
	.type = &bt_mesh_sensor_present_correlated_col_temp,
	.get = cct_get,
	.descriptor = &desc,
};
static struct bt_mesh_sensor chrom_sensor = {
	.type = &bt_mesh_sensor_present_cie_1931_chromaticity_coords,
	.get = chrom_get,
	.descriptor = &desc,
};
static struct bt_mesh_sensor spec_sensor = {
	.type = &spec_type,
	.get = spec_get,
	.descriptor = &desc,
};

static struct bt_mesh_sensor *const sensors[] = {&lux_sensor, &cct_sensor, &chrom_sensor,
						&spec_sensor};
struct bt_mesh_sensor_srv sensor_srv = BT_MESH_SENSOR_SRV_INIT(sensors, ARRAY_SIZE(sensors));

/* ---- Campionamento / pubblicazione ------------------------------------- */

static void publish_all(void)
{
	struct bt_mesh_sensor_value v[SPEC_CH];

	if (!bt_mesh_is_provisioned()) {
		return;
	}
	for (int i = 0; i < ARRAY_SIZE(sensors); i++) {
		if (sensors[i]->get(&sensor_srv, sensors[i], NULL, v)) {
			continue;
		}
		/* -EADDRNOTAVAIL = publicazione non ancora configurata: normale. */
		int err = bt_mesh_sensor_srv_pub(&sensor_srv, NULL, sensors[i], v);

		if (err && err != -EADDRNOTAVAIL) {
			LOG_WRN("pub sensore %d err=%d", i, err);
		}
	}
}

static void sample_fn(struct k_work *w);
static K_WORK_DELAYABLE_DEFINE(sample_work, sample_fn);

static void sample_fn(struct k_work *w)
{
	static int ticks, fails;
	struct as7341_reading r;

	k_work_reschedule(&sample_work, K_SECONDS(SAMPLE_PERIOD_S));
	if (!as7341_present() && !as7341_probe()) {
		return;
	}
	int err = as7341_sample(&r);

	if (err) {
		LOG_WRN("as7341_sample err=%d", err);
		if (++fails >= SAMPLE_FAILS_MAX) { /* sensore sparito o bloccato: riparti da capo */
			fails = 0;
			sensor_invalidate();
			as7341_drop();
		}
		return;
	}
	fails = 0;
	k_mutex_lock(&lock, K_FOREVER);
	if (!r.cct && cache.valid) { /* buio totale: tieni l'ultimo colore noto */
		r.cx = cache.r.cx;
		r.cy = cache.r.cy;
		r.cct = cache.r.cct;
	}
	cache.r = r;
	cache.valid = true;
	float lux = r.lux * lux_cal.k;
	k_mutex_unlock(&lock);

	LOG_INF("%.2f lux  %u K  clear %u  gain %u", (double)lux, r.cct, r.clear, r.gain);
	if (++ticks >= PUBLISH_PERIOD_S / SAMPLE_PERIOD_S) {
		ticks = 0;
		publish_all();
	}
}

void sensor_start(void)
{
	if (!as7341_probe()) {
		LOG_ERR("AS7341 non trovato (controlla cablaggio, 0x39): riprovo ogni %d s",
			SAMPLE_PERIOD_S);
	}
	k_work_reschedule(&sample_work, K_SECONDS(SAMPLE_PERIOD_S));
}
```

## src/shell.c
```c
/* Shell USB CDC: comandi "node ...". */
#include <zephyr/kernel.h>
#include <zephyr/device.h>
#include <zephyr/drivers/i2c.h>
#include <zephyr/shell/shell.h>
#include <zephyr/sys/reboot.h>
#include <zephyr/bluetooth/mesh.h>
#include <hal/nrf_power.h>
#include "node.h"

/* Non esposta nell'header pubblico ma esportata dallo stack. */
extern uint16_t bt_mesh_primary_addr(void);

/* Il bootloader Adafruit entra in DFU seriale se GPREGRET = 0x4e al reset. */
#define DFU_MAGIC 0x4e

static int cmd_reset(const struct shell *sh, size_t argc, char **argv)
{
	shell_print(sh, "reset locale: cancello provisioning e chiavi mesh");
	node_reset_begin();
	bt_mesh_reset();
	return 0;
}

static int cmd_dfu(const struct shell *sh, size_t argc, char **argv)
{
	shell_print(sh, "riavvio nel bootloader DFU...");
	k_msleep(100);
	nrf_power_gpregret_set(NRF_POWER, 0, DFU_MAGIC);
	sys_reboot(SYS_REBOOT_COLD);
	return 0;
}

static int cmd_status(const struct shell *sh, size_t argc, char **argv)
{
	static const char *const names[] = {"provisionabile", "link provisioning", "provisionato",
					    "reset"};
	struct sensor_snap s;

	shell_print(sh, "stato: %s", names[node_get_state()]);
	if (bt_mesh_is_provisioned()) {
		shell_print(sh, "indirizzo: 0x%04x", bt_mesh_primary_addr());
	}
	if (!sensor_snapshot(&s)) {
		shell_print(sh, "nessuna misura valida");
		return 0;
	}
	const struct as7341_reading *r = &s.r;

	shell_print(sh, "%.2f lux (grezzo %.3f, k %.3f)  %u K  gain %u",
		    (double)(r->lux * s.lux_k), (double)r->lux, (double)s.lux_k, r->cct, r->gain);
	shell_print(sh, "F1-F8: %u %u %u %u %u %u %u %u", r->ch[0], r->ch[1], r->ch[2], r->ch[3],
		    r->ch[4], r->ch[5], r->ch[6], r->ch[7]);
	shell_print(sh, "clear %u  NIR %u", r->clear, r->nir);
	return 0;
}

/* Scansione indirizzi 0x08..0x77 su entrambi i bus. */
static int cmd_scan(const struct shell *sh, size_t argc, char **argv)
{
	const struct device *bus[] = {DEVICE_DT_GET(DT_NODELABEL(i2c1)),
				      DEVICE_DT_GET(DT_NODELABEL(i2c0))};
	const char *name[] = {"i2c1 (D4/D5)", "i2c0 (D9/D10)"};

	for (int b = 0; b < ARRAY_SIZE(bus); b++) {
		bool ready = device_is_ready(bus[b]);
		uint8_t id = 0;
		int n = 0;

		shell_print(sh, "%s%s", name[b], ready ? "" : " non pronto");
		if (!ready) {
			continue;
		}
		int rc = i2c_reg_read_byte(bus[b], AS7341_ADDR, AS7341_REG_ID, &id);

		shell_print(sh, "  ID@0x%02x rc=%d id=0x%02x", AS7341_ADDR, rc, id);
		for (uint8_t a = 0x08; a < 0x78; a++) {
			uint8_t d;

			if (i2c_read(bus[b], &d, 1, a) == 0) {
				shell_print(sh, "  0x%02x", a);
				n++;
			}
		}
		shell_print(sh, "  %d dispositivi", n);
	}
	return 0;
}

SHELL_STATIC_SUBCMD_SET_CREATE(node_cmds,
	SHELL_CMD(reset, NULL, "Reset mesh locale (torna provisionabile)", cmd_reset),
	SHELL_CMD(dfu, NULL, "Riavvia nel bootloader (aggiornamento firmware)", cmd_dfu),
	SHELL_CMD(status, NULL, "Stato nodo e ultima misura", cmd_status),
	SHELL_CMD(scan, NULL, "Scansione I2C", cmd_scan),
	SHELL_SUBCMD_SET_END);
SHELL_CMD_REGISTER(node, &node_cmds, "Comandi nodo AS7341", NULL);
```
